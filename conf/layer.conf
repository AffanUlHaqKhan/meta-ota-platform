## conf/layer.conf
```bitbake
BBPATH .= ":${LAYERDIR}"

BBFILES += "${LAYERDIR}/recipes-*/*/*.bb \
            ${LAYERDIR}/recipes-*/*/*.bbappend"

BBFILE_COLLECTIONS += "ota-platform"
BBFILE_PATTERN_ota-platform = "^${LAYERDIR}/"
BBFILE_PRIORITY_ota-platform = "10"

LAYERDEPENDS_ota-platform = "core openembedded-layer meta-python qt6-layer sota"

# Adjust when moving off the LTS branch.
LAYERSERIES_COMPAT_ota-platform = "scarthgap styhead walnascar"
```
